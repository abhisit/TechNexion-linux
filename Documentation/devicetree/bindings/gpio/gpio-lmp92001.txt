## Documentation/devicetree/bindings/gpio/gpio-lmp92001.txt
```
* Texas Instruments' LMP92001 GPIOs

Required properties:
 - compatible: Must be set to "ti,lmp92001-gpio".
 - reg: i2c chip address for the device.
 - gpio-controller: Marks the device node as a gpio controller.
 - #gpio-cells : Should be two.  The first cell is the pin number and
  the second cell is used to specify the gpio polarity:
        0 = Active high
        1 = Active low
- ti,lmp92001-gpio-dir: bit mask for internal pull-down.
        0 = Internal pull-down
        1 = Open

Note:
Since the direction and the internal pull-down are shared register!
To use the GPIO as input must be set gpio-dir mask to 1. Synonym, 1 = [I]nput
and 0 = [O]utput.

Example:
lmp92001@20 {
        compatible = "ti,lmp92001";
        reg = <0x20>;

        lmp92001_gpio: lmp92001-gpio {
                compatible = "ti,lmp92001-gpio";
                gpio-controller;
                #gpio-cells = <2>;
                ti,lmp92001-gpio-dir = /bits/ 8 <0xff>;
        };
};
```
